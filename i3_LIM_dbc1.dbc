VERSION ""

NS_ :

BS_:
BU_: LIM BMS Unknown
BO_ 670 LIMMsg29E: 0 LIM
   SG_ I_Available : 24|16@1+ (0.1,0) [-500|500] "Amps" Vector__XXX
   SG_ V_Avail : 8|16@1+ (0.1,0) [0|1000] "Volts" Vector__XXX

BO_ 751 LIMMsg2EF: 0 LIM
   SG_ MinV_Avail : 0|16@1+ (0.1,0) [0|1000] "Volts" Vector__XXX

BO_ 690 LIMMsg2B2: 0 LIM
   SG_ Battery_Compatability : 38|2@1+ (1,0) [0|1] "" Vector__XXX
   SG_ CHG_Volts : 0|16@1+ (0.1,0) [0|1] "Volts" Vector__XXX
   SG_ CHG_Amps : 16|16@1+ (0.1,0) [-500|500] "Amps" Vector__XXX

BO_ 948 LIMMsg3B4: 0 LIM
   SG_ Pilot_Current : 0|8@1+ (1,0) [0|63] "Amps" Vector__XXX
   SG_ Cable_Current : 8|8@1+ (1,0) [0|63] "Amps" Vector__XXX
   SG_ FC_Voltage : 56|8@1+ (2,0) [0|500] "Volts" Vector__XXX
   SG_ Pilot_Status : 32|3@1+ (1,0) [0|1] "" Vector__XXX
   SG_ PP_Status : 16|1@0+ (1,0) [0|1] "" Vector__XXX
   SG_ CP_Lock_Status : 26|2@1+ (1,0) [0|1] "" Vector__XXX
   SG_ CHG_Flap_Status : 24|2@1+ (1,0) [0|1] "" Vector__XXX
   SG_ Plug_Connection : 37|2@1+ (1,0) [0|1] "" Vector__XXX
   SG_ Charge_End_Sig : 20|2@1+ (1,0) [0|1] "" Vector__XXX
   SG_ HW_Charger_EN : 22|2@1+ (1,0) [0|1] "" Vector__XXX

BO_ 274 BMSMsg112: 0 BMS
   SG_ Battery_Volts : 16|16@1+ (0.1,0) [0|500] "Volts" Vector__XXX
   SG_ zwischenkreis : 56|8@1+ (4,0) [0|1000] "Volts" Vector__XXX
   SG_ Battery_Status : 48|4@1+ (1,0) [0|16] "" Vector__XXX
   SG_ Battery_Current : 0|16@1+ (0.1,-819.2) [0|819] "Amps" Vector__XXX
   SG_ HVBatt_SOC : 32|12@1+ (0.1,0) [0|100] "%" Vector__XXX

BO_ 1001 UnknownMsg3E9: 0 Unknown
   SG_ FC_Current_Command : 40|10@1- (1,0) [-500|500] "Amps" Vector__XXX
   SG_ Contactor_Con : 52|4@1+ (1,0) [0|16] "" Vector__XXX
   SG_ EndOfChg_Time : 56|8@1+ (1,0) [0|255] "Mins" Vector__XXX
   SG_ Chg_Status_Info : 20|4@1+ (1,0) [0|1] "" Vector__XXX
   SG_ Chg_Readiness : 24|2@1+ (1,0) [0|1] "" Vector__XXX
   SG_ DCFC_I_Diff : 26|2@1+ (1,0) [0|1] "" Vector__XXX
   SG_ DCFC_V_Diff : 50|2@1+ (1,0) [0|1] "" Vector__XXX
   SG_ Batt_Energy : 0|16@1+ (1,0) [0|65534] "Wh" Vector__XXX
   SG_ Charge_Req : 16|4@1+ (1,0) [0|16] "" Vector__XXX
   SG_ Charging_Pwr : 28|12@1+ (25,0) [0|102350] "Watts" Vector__XXX

BO_ 762 UnknownMsg2FA: 0 Unknown
   SG_ Chg_End : 18|2@1+ (1,0) [0|1] "" Vector__XXX
   SG_ FC_End : 16|2@1+ (1,0) [0|1] "" LIM
   SG_ Target_CHG_Ph : 20|4@1+ (1,0) [0|1] "" Vector__XXX
   SG_ Time2Go : 0|16@1+ (1,0) [0|65534] "Mins" Vector__XXX

BO_ 753 UnknownMsg2F1: 0 Unknown
   SG_ Time_to_FC_SOC : 40|16@1+ (10,0) [0|655320] "Secs" Vector__XXX
   SG_ Time_to_SOC : 24|16@1+ (10,0) [0|655320] "Secs" Vector__XXX
   SG_ FC_SOC : 56|8@1+ (0.5,0) [0|100] "%" Vector__XXX
   SG_ CHG_I_Lim : 16|8@1+ (1,0) [0|254] "Amps" LIM
   SG_ CHG_V_Lim : 0|14@1- (0.1,0) [0|1000] "Volts" Vector__XXX

BO_ 1073 UnknownMsg431: 0 Unknown
   SG_ Serv_Dis_Status : 0|2@1+ (1,0) [0|1] "" Vector__XXX
   SG_ Total_Battery : 40|12@1+ (0.02,0) [0|82] "kWh" Vector__XXX

BO_ 1074 UnknownMsg432: 0 Unknown
   SG_ Voltage_Setpoint : 4|12@1+ (0.1,0) [0|410] "Volts" Vector__XXX
   SG_ Displayed_SOC : 32|8@1+ (0.5,0) [0|100] "%" Vector__XXX

BO_ 626 LIMMsg272: 0 LIM
   SG_ FC_Contactor_State : 18|6@1+ (1,0) [0|24] "" Vector__XXX
   SG_ ChargeFlap_Status : 16|2@1+ (1,0) [0|4] "" Vector__XXX
   SG_ FC_Contactor_Test : 19|1@0+ (1,0) [0|1] "" Vector__XXX

BA_DEF_ BO_ "GenMsgBackgroundColor" STRING ;
BA_DEF_ BO_ "GenMsgForegroundColor" STRING ;
BA_DEF_ BO_ "filterlabeling" INT 0 0;
BA_DEF_ BO_ "filterlabeling" INT 0 0;
BA_DEF_ BO_ "filterlabeling" INT 0 0;
BA_DEF_ BO_ "filterlabeling" INT 0 0;
BA_DEF_ BO_ "filterlabeling" INT 0 0;
BA_DEF_ BO_ "filterlabeling" INT 0 0;
BA_DEF_ BO_ "filterlabeling" INT 0 0;
BA_DEF_ BO_ "filterlabeling" INT 0 0;
BA_DEF_ BO_ "filterlabeling" INT 0 0;
BA_DEF_ BO_ "filterlabeling" INT 0 0;
BA_DEF_ BO_ "filterlabeling" INT 0 0;
BA_DEF_DEF_ "GenMsgBackgroundColor" "#ffffff";
BA_DEF_DEF_ "GenMsgForegroundColor" "#000000";
BA_DEF_DEF_ "filterlabeling" 0;
BA_DEF_DEF_ "filterlabeling" true;
CM_ BU_ Unknown "Lim Command";
VAL_ 690 Battery_Compatability 0 "Compatible" 1 "Incompatible" 3 "Signal_error";
VAL_ 948 FC_Voltage 251 "AC_Charge" 254 "Error" 252 "Not_Available";
VAL_ 948 Pilot_Status 0 "No_Pilot" 1 "AC_Not_Ready" 2 "AC_Ready" 3 "Error" 4 "5%_Not_Ready" 5 "5%_Ready" 6 "Pilot_Static";
VAL_ 948 PP_Status 0 "Unplugged" 1 "Plug_Inserted";
VAL_ 274 Battery_Status 5 "Normal";
VAL_ 762 Target_CHG_Ph 0 "Standby" 1 "Initialisation" 2 "Subpoena" 3 "Energy_Transfer" 4 "Turn_Off" 15 "Reserved" 14 "Reserved" 0 "No Description";
VAL_ 626 FC_Contactor_Test 0 "Fail" 1 "Pass";
